## CMakeLists.txt
```
#
#  Copyright (c) 2025 Nordic Semiconductor ASA
#
#  SPDX-License-Identifier: LicenseRef-Nordic-5-Clause
#


cmake_minimum_required(VERSION 3.20.0)

find_package(Zephyr HINTS $ENV{ZEPHYR_BASE})

project(matter-closure)

# Enable GNU STD support.
include(${ZEPHYR_CONNECTEDHOMEIP_MODULE_DIR}/config/nrfconnect/app/enable-gnu-std.cmake)

# NORDIC SDK APP START

# Include all source files that are located in the Matter common directory.
include(${ZEPHYR_NRF_MODULE_DIR}/samples/matter/common/cmake/source_common.cmake)

# Include Data Model utils
include(${ZEPHYR_NRF_MODULE_DIR}/samples/matter/common/cmake/data_model.cmake)

include(${ZEPHYR_NRF_MODULE_DIR}/samples/matter/common/cmake/zap_helpers.cmake)
ncs_get_zap_parent_dir(ZAP_PARENT_DIR)

target_include_directories(app PRIVATE
  src
  ${ZEPHYR_NRF_MODULE_DIR}/samples/matter/common/src/util
  ${ZAP_PARENT_DIR}
)

target_sources(app PRIVATE
  src/app_task.cpp
  src/main.cpp
  src/closure_manager.cpp
  src/closure_control_endpoint.cpp
  src/physical_emulator.cpp
)

ncs_configure_data_model()
# NORDIC SDK APP END
```

## Kconfig
```
#
# Copyright (c) 2022 Nordic Semiconductor
#
# SPDX-License-Identifier: LicenseRef-Nordic-5-Clause
#
mainmenu "Matter nRF Connect Closure Example Application"

# Sample configuration used for Thread networking
if OPENTHREAD

choice OPENTHREAD_NORDIC_LIBRARY_CONFIGURATION
	default OPENTHREAD_NORDIC_LIBRARY_MTD
endchoice

choice OPENTHREAD_DEVICE_TYPE
	default OPENTHREAD_MTD
endchoice

endif # OPENTHREAD

config CHIP_WIFI
	default y if BOARD_NRF7002DK_NRF5340_CPUAPP

source "$(ZEPHYR_CONNECTEDHOMEIP_MODULE_DIR)/config/nrfconnect/chip-module/Kconfig.features"
source "$(ZEPHYR_CONNECTEDHOMEIP_MODULE_DIR)/config/nrfconnect/chip-module/Kconfig.defaults"
source "$(ZEPHYR_NRF_MODULE_DIR)/samples/matter/common/src/Kconfig"
source "Kconfig.zephyr"
```

## sample.yaml
```
sample:
  description: Matter Closure sample
  name: Matter Closure
common:
  tags:
    - sysbuild
    - ci_samples_matter
tests:
  sample.matter.closure.debug:
    sysbuild: true
    build_only: true
    extra_args:
      - CONFIG_NCS_SAMPLE_MATTER_OPERATIONAL_KEYS_MIGRATION_TO_ITS=y
    integration_platforms:
      - nrf52840dk/nrf52840
      - nrf5340dk/nrf5340/cpuapp
      - nrf7002dk/nrf5340/cpuapp
      - nrf54l15dk/nrf54l15/cpuapp
      - nrf54l15dk/nrf54l15/cpuapp/ns
      - nrf54l15dk/nrf54l10/cpuapp
      - nrf54lm20dk/nrf54lm20a/cpuapp
    platform_allow:
      - nrf52840dk/nrf52840
      - nrf5340dk/nrf5340/cpuapp
      - nrf7002dk/nrf5340/cpuapp
      - nrf54l15dk/nrf54l15/cpuapp
      - nrf54l15dk/nrf54l15/cpuapp/ns
      - nrf54l15dk/nrf54l10/cpuapp
      - nrf54lm20dk/nrf54lm20a/cpuapp
  sample.matter.closure.release:
    sysbuild: true
    build_only: true
    extra_args:
      - FILE_SUFFIX=release
      - CONFIG_NCS_SAMPLE_MATTER_OPERATIONAL_KEYS_MIGRATION_TO_ITS=y
    integration_platforms:
      - nrf52840dk/nrf52840
      - nrf5340dk/nrf5340/cpuapp
      - nrf7002dk/nrf5340/cpuapp
      - nrf54l15dk/nrf54l15/cpuapp
      - nrf54l15dk/nrf54l15/cpuapp/ns
      - nrf54l15dk/nrf54l10/cpuapp
      - nrf54lm20dk/nrf54lm20a/cpuapp
    platform_allow:
      - nrf52840dk/nrf52840
      - nrf5340dk/nrf5340/cpuapp
      - nrf7002dk/nrf5340/cpuapp
      - nrf54l15dk/nrf54l15/cpuapp
      - nrf54l15dk/nrf54l15/cpuapp/ns
      - nrf54l15dk/nrf54l10/cpuapp
      - nrf54lm20dk/nrf54lm20a/cpuapp
  sample.matter.closure.smp_dfu:
    sysbuild: true
    build_only: true
    extra_args:
      - CONFIG_CHIP_DFU_OVER_BT_SMP=y
      - CONFIG_NCS_SAMPLE_MATTER_OPERATIONAL_KEYS_MIGRATION_TO_ITS=y
    integration_platforms:
      - nrf52840dk/nrf52840
      - nrf5340dk/nrf5340/cpuapp
      - nrf7002dk/nrf5340/cpuapp
      - nrf54l15dk/nrf54l15/cpuapp
      - nrf54l15dk/nrf54l15/cpuapp/ns
      - nrf54l15dk/nrf54l10/cpuapp
      - nrf54lm20dk/nrf54lm20a/cpuapp
    platform_allow:
      - nrf52840dk/nrf52840
      - nrf5340dk/nrf5340/cpuapp
      - nrf7002dk/nrf5340/cpuapp
      - nrf54l15dk/nrf54l15/cpuapp
      - nrf54l15dk/nrf54l15/cpuapp/ns
      - nrf54l15dk/nrf54l10/cpuapp
      - nrf54lm20dk/nrf54lm20a/cpuapp
  sample.matter.closure.release.internal:
    sysbuild: true
    build_only: true
    extra_args:
      - FILE_SUFFIX=internal
      - closure_EXTRA_CONF_FILE=prj_release.conf
    integration_platforms:
      - nrf54l15dk/nrf54l15/cpuapp
      - nrf54lm20dk/nrf54lm20a/cpuapp
    platform_allow:
      - nrf54l15dk/nrf54l15/cpuapp
      - nrf54lm20dk/nrf54lm20a/cpuapp
  sample.matter.closure.release.internal.smp_dfu:
    sysbuild: true
    build_only: true
    extra_args:
      - FILE_SUFFIX=internal
      - CONFIG_CHIP_DFU_OVER_BT_SMP=y
      - closure_EXTRA_CONF_FILE=prj_release.conf
    integration_platforms:
      - nrf54l15dk/nrf54l15/cpuapp
      - nrf54lm20dk/nrf54lm20a/cpuapp
    platform_allow:
      - nrf54l15dk/nrf54l15/cpuapp
      - nrf54lm20dk/nrf54lm20a/cpuapp
  sample.matter.closure.cc3xx_backend:
    sysbuild: true
    build_only: true
    extra_args:
      - CONFIG_PSA_CRYPTO_DRIVER_CC3XX=y
    integration_platforms:
      - nrf52840dk/nrf52840
      - nrf5340dk/nrf5340/cpuapp
    platform_allow:
      - nrf52840dk/nrf52840
      - nrf5340dk/nrf5340/cpuapp
  sample.matter.closure.smp_dfu.old_ec:
    sysbuild: true
    build_only: true
    extra_args:
      - CONFIG_CHIP_DFU_OVER_BT_SMP=y
      - SB_CONFIG_BOOT_SIGNATURE_TYPE_RSA=y
      - CONFIG_SETTINGS_ZMS_LEGACY=y
    integration_platforms:
      - nrf54l15dk/nrf54l15/cpuapp
    platform_allow:
      - nrf54l15dk/nrf54l15/cpuapp
  sample.matter.closure.certification:
    sysbuild: true
    build_only: true
    extra_args:
      - CONFIG_NCS_SAMPLE_MATTER_CERTIFICATION=y
      - OVERLAY_CONFIG="../common/src/certification/thread_platform/overlay-thread_platform.conf"
      - closure_SNIPPET="diagnostic-logs;matter-debug"
    integration_platforms:
      - nrf52840dk/nrf52840
      - nrf5340dk/nrf5340/cpuapp
      - nrf54l15dk/nrf54l15/cpuapp
      - nrf54lm20dk/nrf54lm20a/cpuapp
    platform_allow:
      - nrf52840dk/nrf52840
      - nrf5340dk/nrf5340/cpuapp
      - nrf54l15dk/nrf54l15/cpuapp
      - nrf54lm20dk/nrf54lm20a/cpuapp
```

## prj.conf
```kconfig
#
# Copyright (c) 2021 Nordic Semiconductor ASA
#
# SPDX-License-Identifier: LicenseRef-Nordic-5-Clause
#

# This sample uses Kconfig.defaults to set options common for all
# samples. This file should contain only options specific for this sample
# or overrides of default values.

CONFIG_DK_LIBRARY=y
CONFIG_PWM=y

# Enable CHIP
CONFIG_CHIP=y
CONFIG_CHIP_PROJECT_CONFIG="src/chip_project_config.h"
CONFIG_CHIP_DEVICE_PRODUCT_NAME="Matter Closure"

# Configure ZAP file name
CONFIG_NCS_SAMPLE_MATTER_ZAP_FILE_PATH="${APPLICATION_CONFIG_DIR}/src/default_zap/closure.zap"

# 32768 == 0x8000 (example Product ID added temporaly,
# but it must be changed with proper PID from the list:
# https://github.com/project-chip/connectedhomeip/blob/482e6fd03196a6de45465a90003947ef4b86e0b1/docs/examples/discussion/PID_allocation_for_example_apps.md)
CONFIG_CHIP_DEVICE_PRODUCT_ID=32768
CONFIG_STD_CPP17=y

# Enable Matter pairing automatically on application start.
CONFIG_CHIP_ENABLE_PAIRING_AUTOSTART=y

# Enable Matter extended announcement and increase duration to 1 hour.
CONFIG_CHIP_BLE_EXT_ADVERTISING=y
CONFIG_CHIP_BLE_ADVERTISING_DURATION=60

# Add support for LEDs and buttons on Nordic development kits
CONFIG_DK_LIBRARY=y

# Bluetooth Low Energy configuration
CONFIG_BT_DEVICE_NAME="MatterClosure"

# Other settings
CONFIG_THREAD_NAME=y
CONFIG_MPU_STACK_GUARD=y
CONFIG_RESET_ON_FATAL_ERROR=n
CONFIG_CHIP_LIB_SHELL=y
CONFIG_NCS_SAMPLE_MATTER_TEST_SHELL=y

# Disable NFC onboarding
CONFIG_CHIP_NFC_ONBOARDING_PAYLOAD=n

# Reduce application size
CONFIG_USE_SEGGER_RTT=n

# Enable Factory Data feature
CONFIG_CHIP_FACTORY_DATA=y
CONFIG_CHIP_FACTORY_DATA_BUILD=y
```

## prj_release.conf
```kconfig
#
# Copyright (c) 2021 Nordic Semiconductor ASA
#
# SPDX-License-Identifier: LicenseRef-Nordic-5-Clause
#

# This sample uses Kconfig.defaults to set options common for all
# samples. This file should contain only options specific for this sample
# or overrides of default values.

# Enable CHIP
CONFIG_CHIP=y
CONFIG_CHIP_PROJECT_CONFIG="src/chip_project_config.h"
CONFIG_CHIP_DEVICE_PRODUCT_NAME="Matter Closure"

# Configure ZAP file name
CONFIG_NCS_SAMPLE_MATTER_ZAP_FILE_PATH="${APPLICATION_CONFIG_DIR}/src/default_zap/closure.zap"

# 32768 == 0x8000 (example Product ID added temporaly,
# but it must be changed with proper PID from the list:
# https://github.com/project-chip/connectedhomeip/blob/482e6fd03196a6de45465a90003947ef4b86e0b1/docs/examples/discussion/PID_allocation_for_example_apps.md)
CONFIG_CHIP_DEVICE_PRODUCT_ID=32768
CONFIG_STD_CPP17=y

# Enable Matter pairing automatically on application start.
CONFIG_CHIP_ENABLE_PAIRING_AUTOSTART=y

# Enable Matter extended announcement and increase duration to 1 hour.
CONFIG_CHIP_BLE_EXT_ADVERTISING=y
CONFIG_CHIP_BLE_ADVERTISING_DURATION=60

# Add support for LEDs and buttons on Nordic development kits
CONFIG_DK_LIBRARY=y

# Bluetooth Low Energy configuration
CONFIG_BT_DEVICE_NAME="MatterClosure"

# Enable system reset on fatal error
CONFIG_RESET_ON_FATAL_ERROR=y

# Disable all debug features
CONFIG_USE_SEGGER_RTT=n
CONFIG_SHELL=n
CONFIG_OPENTHREAD_SHELL=n
CONFIG_CHIP_LIB_SHELL=n
CONFIG_CONSOLE=n
CONFIG_UART_CONSOLE=n
CONFIG_SERIAL=n
CONFIG_LOG=n
CONFIG_LOG_MODE_MINIMAL=n
CONFIG_ASSERT_VERBOSE=n
CONFIG_ASSERT_NO_FILE_INFO=y
CONFIG_PRINTK=n
CONFIG_PRINTK_SYNC=n
CONFIG_THREAD_NAME=n
CONFIG_BOOT_BANNER=n

# Disable NFC onboarding
CONFIG_CHIP_NFC_ONBOARDING_PAYLOAD=n

# Enable Factory Data feature
CONFIG_CHIP_FACTORY_DATA=y
CONFIG_CHIP_FACTORY_DATA_BUILD=y

# Enable Watchdog
CONFIG_NCS_SAMPLE_MATTER_WATCHDOG=y

# Enable LTO to decrease the flash usage.
CONFIG_LTO=y
CONFIG_ISR_TABLES_LOCAL_DECLARATION=y
```

## src/ClosureControlEndpoint.cpp
```c
/*
 *
 *    Copyright (c) 2025 Project CHIP Authors
 *    All rights reserved.
 *
 *    Licensed under the Apache License, Version 2.0 (the "License");
 *    you may not use this file except in compliance with the License.
 *    You may obtain a copy of the License at
 *
 *        http://www.apache.org/licenses/LICENSE-2.0
 *
 *    Unless required by applicable law or agreed to in writing, software
 *    distributed under the License is distributed on an "AS IS" BASIS,
 *    WITHOUT WARRANTIES OR CONDITIONS OF ANY KIND, either express or implied.
 *    See the License for the specific language governing permissions and
 *    limitations under the License.
 */

#include "ClosureControlEndpoint.h"
#include "ClosureManager.h"
#include <app-common/zap-generated/cluster-enums.h>
#include <app-common/zap-generated/cluster-objects.h>
#include <protocols/interaction_model/StatusCode.h>
#include <app-common/zap-generated/attributes/Accessors.h>

#include <zephyr/logging/log.h>

LOG_MODULE_DECLARE(closure_cntrl, CONFIG_CHIP_APP_LOG_LEVEL);

using namespace chip;
using namespace chip::app::Clusters::ClosureControl;

using Protocols::InteractionModel::Status;

namespace {

constexpr ElapsedS kDefaultCountdownTime = 30;

} // namespace

Status ClosureControlDelegate::HandleCalibrateCommand()
{
    return ClosureManager::GetInstance().OnCalibrateCommand();
}

Status ClosureControlDelegate::HandleMoveToCommand(const Optional<TargetPositionEnum> & position, const Optional<bool> & latch,
                                                   const Optional<Globals::ThreeLevelAutoEnum> & speed)
{
    return ClosureManager::GetInstance().OnMoveToCommand(position, latch, speed);
}

Status ClosureControlDelegate::HandleStopCommand()
{
    return ClosureManager::GetInstance().OnStopCommand();
}

CHIP_ERROR ClosureControlDelegate::GetCurrentErrorAtIndex(size_t index, ClosureErrorEnum & closureError)
{
    // This function should return the current error at the specified index.
    // For now, we dont have a ErrorList implemented, so will return CHIP_ERROR_PROVIDER_LIST_EXHAUSTED.
    return CHIP_ERROR_PROVIDER_LIST_EXHAUSTED;
}

bool ClosureControlDelegate::IsReadyToMove()
{
    // This function should return true if the closure is ready to move.
    // For now, we will return true.
    return true;
}

bool ClosureControlDelegate::IsManualLatchingNeeded()
{
    // This function should return true if manual latching is needed.
    // For now, we will return false.
    return false;
}

ElapsedS ClosureControlDelegate::GetCalibrationCountdownTime()
{
    // This function should return the calibration countdown time.
    // For now, we will return kDefaultCountdownTime.
    return kDefaultCountdownTime;
}

ElapsedS ClosureControlDelegate::GetMovingCountdownTime()
{
    // This function should return the moving countdown time.
    // For now, we will return kDefaultCountdownTime.
    return kDefaultCountdownTime;
}

ElapsedS ClosureControlDelegate::GetWaitingForMotionCountdownTime()
{
    // This function should return the waiting for motion countdown time.
    // For now, we will return kDefaultCountdownTime.
    return kDefaultCountdownTime;
}

CHIP_ERROR ClosureControlEndpoint::Init()
{
    ClusterConformance conformance;
    conformance.FeatureMap()
        .Set(Feature::kPositioning)
        .Set(Feature::kSpeed)
        .Set(Feature::kVentilation);
    conformance.OptionalAttributes().Set(OptionalAttributeEnum::kCountdownTime);

    ClusterInitParameters initParams;

    ReturnErrorOnFailure(mLogic.Init(conformance, initParams));
    ReturnErrorOnFailure(mInterface.Init());

    return CHIP_NO_ERROR;
}

void ClosureControlEndpoint::WriteAllAttributes(
    const MainStateEnum& mainState,
    const GenericOverallCurrentState& currentState,
    const GenericOverallTargetState& targetState)
{
    DeviceLayer::PlatformMgr().LockChipStack();
    CHIP_ERROR err = mLogic.SetMainState(mainState);
    if (err != CHIP_NO_ERROR){
        LOG_INF("\n\nThe main state set was not successful: %s\n\n",chip::ErrorStr(err));
    }
    err = mLogic.SetOverallCurrentState(currentState);
    if (err != CHIP_NO_ERROR){
        LOG_INF("\n\nThe current state set was not successful: %s\n\n",chip::ErrorStr(err));
    }
    err = mLogic.SetOverallTargetState(targetState);
    if (err != CHIP_NO_ERROR){
        LOG_INF("\n\nThe target state set was not successful: %s\n\n",chip::ErrorStr(err));
    }
    DeviceLayer::PlatformMgr().UnlockChipStack();
}

void ClosureControlEndpoint::OnStopCalibrateComplete()
{
    LOG_INF("\nOnStopCalibrateActionComplete\n");
}

void ClosureControlEndpoint::OnStopMotionComplete()
{
    LOG_INF("\nOnStopMotionActionComplete\n");
}

void ClosureControlEndpoint::OnCalibrateComplete()
{
    LOG_INF("\nOnCalibrateActionComplete\n");
}

void ClosureControlEndpoint::OnMoveToComplete()
{
    LOG_INF("\nOnMoveToActionComplete\n");
}
```

## src/ClosureManager.cpp
```c
/*
 *
 *    Copyright (c) 2025 Project CHIP Authors
 *    All rights reserved.
 *
 *    Licensed under the Apache License, Version 2.0 (the "License");
 *    you may not use this file except in compliance with the License.
 *    You may obtain a copy of the License at
 *
 *        http://www.apache.org/licenses/LICENSE-2.0
 *
 *    Unless required by applicable law or agreed to in writing, software
 *    distributed under the License is distributed on an "AS IS" BASIS,
 *    WITHOUT WARRANTIES OR CONDITIONS OF ANY KIND, either express or implied.
 *    See the License for the specific language governing permissions and
 *    limitations under the License.
 */

#include "ClosureManager.h"
#include "ClosureControlEndpoint.h"

#include <app-common/zap-generated/cluster-objects.h>
#include <app/util/attribute-storage.h>
#include <platform/CHIPDeviceLayer.h>
#include <dk_buttons_and_leds.h>

#include <app-common/zap-generated/attributes/Accessors.h>

#include <zephyr/logging/log.h>
#include <zephyr/kernel.h>

#include <map>

LOG_MODULE_DECLARE(closure_manager, CONFIG_CHIP_APP_LOG_LEVEL);

using namespace chip;
using namespace chip::app;
using namespace chip::DeviceLayer;
using namespace chip::app::Clusters::ClosureControl;
using namespace chip::app::Clusters::Globals;

static const struct pwm_dt_spec sPhysicalIndicatorPwmDevice = PWM_DT_SPEC_GET(DT_ALIAS(pwm_led1));

const static std::map<TargetPositionEnum, uint16_t> sPositionMap = {
    {TargetPositionEnum::kMoveToFullyClosed,10000},
    {TargetPositionEnum::kMoveToFullyOpen,0},
    {TargetPositionEnum::kMoveToPedestrianPosition,0},
    {TargetPositionEnum::kMoveToSignaturePosition, 0},
    {TargetPositionEnum::kMoveToVentilationPosition,7500},
};

const static std::map<CurrentPositionEnum, uint16_t> sPositionMapCurr = {
    {CurrentPositionEnum::kFullyClosed,10000},
    {CurrentPositionEnum::kFullyOpened,0},
    {CurrentPositionEnum::kOpenedForPedestrian,0},
    {CurrentPositionEnum::kOpenedAtSignature, 0},
    {CurrentPositionEnum::kOpenedForVentilation,7500},
};

const static std::map<Clusters::Globals::ThreeLevelAutoEnum,uint16_t> sSpeedMap = {
    {ThreeLevelAutoEnum::kLow, 1000},
    {ThreeLevelAutoEnum::kMedium, 2500},
    {ThreeLevelAutoEnum::kHigh, 5000},
    {ThreeLevelAutoEnum::kAuto, 2500},
};

namespace {
constexpr uint32_t kCountdownTimeSeconds = 10;

// Define the Namespace and Tag for the endpoint
constexpr uint8_t kNamespaceClosure   = 0x44;
constexpr uint8_t kTagClosureGarageDoor = 0x05;

// Define the list of semantic tags for the endpoint
const Clusters::Descriptor::Structs::SemanticTagStruct::Type kClosureControlEndpointTagList[] = {
    { .namespaceID = kNamespaceClosure,
      .tag         = kTagClosureGarageDoor,
      .label       = chip::MakeOptional(DataModel::Nullable<chip::CharSpan>("Closure.GarageDoor"_span)) }
};

} // namespace

CurrentPositionEnum ExactPos2Enum(uint16_t currPositionExact){

    for (const auto &entry : sPositionMapCurr)
    {
        const auto &positionEnum = entry.first;
        const uint16_t positionValue = entry.second;

        if (currPositionExact == positionValue)
        {
            return positionEnum;
        }
    }
    return CurrentPositionEnum::kPartiallyOpened;
}

ClosureManager ClosureManager::sClosureMgr;

ClosureManager::ClosureManager()
    : mPhysicalEmulator(&sPhysicalIndicatorPwmDevice)
{
    mMainState = MainStateEnum::kStopped;
    mCurrentState.position = chip::MakeOptional(CurrentPositionEnum::kFullyOpened);
    mCurrentState.speed = chip::MakeOptional(ThreeLevelAutoEnum::kAuto);
    mCurrentState.secureState = chip::MakeOptional(false);
    mTargetState.speed = chip::MakeOptional(ThreeLevelAutoEnum::kAuto);
}

void ClosureManager::Init()
{
    LOG_INF("\nINIT\n");

    mPhysicalEmulator.Init();

    DeviceLayer::PlatformMgr().LockChipStack();

    // Closure endpoints initialization
    ClosureControlEndpoint.Init();

    // Set Taglist for Closure endpoints
    SetTagList(/* endpoint= */ 1, Span<const Clusters::Descriptor::Structs::SemanticTagStruct::Type>(kClosureControlEndpointTagList));

    ClosureControlEndpoint.WriteAllAttributes(mMainState,mCurrentState,mTargetState);

    DeviceLayer::PlatformMgr().UnlockChipStack();
}

chip::Protocols::InteractionModel::Status ClosureManager::OnCalibrateCommand()
{
    return chip::Protocols::InteractionModel::Status::UnsupportedCommand;
}

chip::Protocols::InteractionModel::Status ClosureManager::OnStopCommand()
{
    mPhysicalEmulator.Stop();
    return chip::Protocols::InteractionModel::Status::Success;
}
chip::Protocols::InteractionModel::Status
ClosureManager::OnMoveToCommand(const chip::Optional<TargetPositionEnum> position,
                                const chip::Optional<bool> latch,
                                const chip::Optional<ThreeLevelAutoEnum> speed)
{
    if (!position.HasValue()){
        return chip::Protocols::InteractionModel::Status::Failure;
    }
    auto pos = sPositionMap.at(position.Value());
    auto spd = sSpeedMap.at(speed.ValueOr(mCurrentState.speed.Value()));
    mPhysicalEmulator.MoveTo(pos,spd);

    mMainState = MainStateEnum::kMoving;
    mTargetState.position = position;
    mTargetState.speed = speed;

    ClosureControlEndpoint.WriteAllAttributes(mMainState,mCurrentState,mTargetState);

    return chip::Protocols::InteractionModel::Status::Success;
}

void ClosureManager::HandleClosureCallback(MainStateEnum newState, uint16_t currPositionExact)
{
    switch (newState)
    {
    case MainStateEnum::kStopped: {
        mCurrentState.position = MakeOptional(ExactPos2Enum(currPositionExact));
        mCurrentState.speed = mTargetState.speed;
        mMainState = MainStateEnum::kStopped;
        mTargetState.position.ClearValue();
    }
    default:
        ChipLogError(AppServer, "Invalid action received in HandleClosureCallback");
        break;
    }
    ClosureControlEndpoint.WriteAllAttributes(mMainState,mCurrentState,mTargetState);
}
```

## src/PhysicalEmulator.cpp
```c
#include "PhysicalEmulator.h"
#include <app-common/zap-generated/attributes/Accessors.h>
#include <zephyr/logging/log.h>
#include "ClosureManager.h"

LOG_MODULE_DECLARE(app, CONFIG_CHIP_APP_LOG_LEVEL);

using namespace chip;
using namespace chip::DeviceLayer;

static constexpr uint32_t kMoveIntervalMs = 100;

PhysicalEmulator::PhysicalEmulator(const pwm_dt_spec *spec) : mSpec(spec){}

CHIP_ERROR PhysicalEmulator::Init()
{
    if (mPhysicalIndicator.Init(mSpec, 0, 255) != 0) {
        LOG_ERR("Cannot initialize the physical indicator");
        return CHIP_ERROR_INCORRECT_STATE;
    }
    LOG_INF("PhysicalEmulator initialized");
    return CHIP_NO_ERROR;
}

CHIP_ERROR PhysicalEmulator::MoveTo(uint16_t position, uint16_t speed)
{
    LOG_INF("Starting movement");
    mTargetPosition = position;
    mSpeed = speed;

    // Start periodic timer
    (void)SystemLayer().StartTimer(System::Clock::Milliseconds32(kMoveIntervalMs),
                                   TimerTimeoutCallback, this);
    return CHIP_NO_ERROR;
}

CHIP_ERROR PhysicalEmulator::Stop()
{
    SystemLayer().CancelTimer(TimerTimeoutCallback, this);
    LOG_INF("Movement stopped");
    ClosureManager::GetInstance().HandleClosureCallback(chip::app::Clusters::ClosureControl::MainStateEnum::kStopped,mCurrentPosition);
    return CHIP_NO_ERROR;
}

void PhysicalEmulator::TimerTimeoutCallback(System::Layer *systemLayer, void *appState)
{
    auto *self = static_cast<PhysicalEmulator *>(appState);
    VerifyOrReturn(self != nullptr);
    self->HandleTimer();
}

void PhysicalEmulator::HandleTimer()
{
    LOG_DBG("Timer tick - updating position or PWM");
    bool finished = false;
    // Example PWM update
    uint32_t move_per_tick_32 = (static_cast<uint32_t>(mSpeed) * kMoveIntervalMs) / 1000U;
    uint16_t move_per_tick = static_cast<uint16_t>(std::min<uint32_t>(move_per_tick_32, UINT16_MAX));
    if (mCurrentPosition <= mTargetPosition){
        if (mCurrentPosition + move_per_tick >= mTargetPosition){
            finished = true;
            mCurrentPosition = mTargetPosition;
        }
        else{
            mCurrentPosition += move_per_tick;
        }
    }else{
        if(mTargetPosition + move_per_tick >= mCurrentPosition ){
            finished = true;
            mCurrentPosition = mTargetPosition;
        }
        else{
            mCurrentPosition -= move_per_tick;
        }
    }

    uint8_t brightness = static_cast<uint8_t>(
        (static_cast<uint32_t>(mCurrentPosition) * 255U + 5000U) / 10000U
    );

    mPhysicalIndicator.InitiateAction(Nrf::PWMDevice::LEVEL_ACTION, 0, &brightness);

    if(finished){
        Stop();
    }else{
        (void)SystemLayer().StartTimer(System::Clock::Milliseconds32(kMoveIntervalMs),
                                   TimerTimeoutCallback, this);
    }
}
```

## src/app_task.cpp
```c
#include "app_task.h"

#include "app/matter_init.h"
#include "app/task_executor.h"
#include "board/board.h"
#include "lib/core/CHIPError.h"
#include "lib/support/CodeUtils.h"
#include "ClosureControlEndpoint.h"
#include "ClosureManager.h"

#include <setup_payload/OnboardingCodesUtil.h>
#include <app/util/attribute-storage.h>
#include <app-common/zap-generated/ids/Clusters.h>
#include <app-common/zap-generated/ids/Attributes.h>
#include <app/data-model/Nullable.h>

#include <zephyr/logging/log.h>

LOG_MODULE_DECLARE(app, CONFIG_CHIP_APP_LOG_LEVEL);

using namespace ::chip;
using namespace ::chip::app;
using namespace ::chip::DeviceLayer;
using namespace chip::app::Clusters::Descriptor;

CHIP_ERROR AppTask::Init()
{
    ReturnErrorOnFailure(Nrf::Matter::PrepareServer());

    if (!Nrf::GetBoard().Init()) {
        LOG_ERR("User interface initialization failed.");
        return CHIP_ERROR_INCORRECT_STATE;
    }

    ReturnErrorOnFailure(Nrf::Matter::RegisterEventHandler(Nrf::Board::DefaultMatterEventHandler, 0));

    ReturnErrorOnFailure(Nrf::Matter::StartServer());

    ClosureManager::GetInstance().Init();

    return CHIP_NO_ERROR;
}

CHIP_ERROR AppTask::StartApp()
{
    ReturnErrorOnFailure(Init());

    while (true) {
        Nrf::DispatchNextTask();
    }

    return CHIP_NO_ERROR;
}
```

## src/app_task.h
```c
/*
 * Copyright (c) 2025 Nordic Semiconductor ASA
 *
 * SPDX-License-Identifier: LicenseRef-Nordic-5-Clause
 */
#pragma once
#include "closure_manager.h"
#include "physical_emulator.h"

static constexpr chip::EndpointId kClosureEndpoint = 1;

class AppTask {
public:
	AppTask();
	static AppTask &Instance()
	{
		static AppTask sAppTask;
		return sAppTask;
	}

	CHIP_ERROR Init();
	CHIP_ERROR StartApp();

private:
	PhysicalEmulator mPhysicalDevice;
	ClosureManager mClosureManager;
};
```

## src/closure_control_endpoint.cpp
```c
/*
 * Copyright (c) 2025 Nordic Semiconductor ASA
 *
 * SPDX-License-Identifier: LicenseRef-Nordic-5-Clause
 */

#include "closure_control_endpoint.h"
#include "closure_manager.h"
#include <app-common/zap-generated/attributes/Accessors.h>
#include <app-common/zap-generated/cluster-enums.h>
#include <app-common/zap-generated/cluster-objects.h>
#include <platform/CHIPDeviceLayer.h>
#include <protocols/interaction_model/StatusCode.h>
#include <zephyr/logging/log.h>

LOG_MODULE_DECLARE(closure_cntrl, CONFIG_CHIP_APP_LOG_LEVEL);

using namespace chip;
using namespace chip::app::Clusters::ClosureControl;

using Status = chip::Protocols::InteractionModel::Status;
using TargetPositionEnum = chip::app::Clusters::ClosureControl::TargetPositionEnum;
using ThreeLevelAutoEnum = chip::app::Clusters::Globals::ThreeLevelAutoEnum;
using OptionalAttributeEnum = chip::app::Clusters::ClosureControl::OptionalAttributeEnum;
namespace
{

constexpr ElapsedS kDefaultCountdownTime = 30;

}

Status ClosureControlDelegate::HandleCalibrateCommand()
{
	if (mManager == nullptr) {
		LOG_ERR("No manager bound to ClosureControlDelegate");
		return Status::Failure;
	}
	return mManager->OnCalibrateCommand();
}

Status ClosureControlDelegate::HandleMoveToCommand(const chip::Optional<TargetPositionEnum> &position,
						   const chip::Optional<bool> &latch,
						   const chip::Optional<ThreeLevelAutoEnum> &speed)
{
	if (mManager == nullptr) {
		LOG_ERR("No manager bound to ClosureControlDelegate");
		return Status::Failure;
	}
	return mManager->OnMoveToCommand(position, latch, speed);
}

Status ClosureControlDelegate::HandleStopCommand()
{
	if (mManager == nullptr) {
		LOG_ERR("No manager bound to ClosureControlDelegate");
		return Status::Failure;
	}
	return mManager->OnStopCommand();
}

bool ClosureControlDelegate::IsReadyToMove()
{
	/* This function should return true if the closure is ready to move.
	   For now, we will return true. */
	return true;
}

ElapsedS ClosureControlDelegate::GetCalibrationCountdownTime()
{
	/* This function should return the calibration countdown time.
	   For now, we will return kDefaultCountdownTime. */
	return kDefaultCountdownTime;
}

ElapsedS ClosureControlDelegate::GetMovingCountdownTime()
{
	return mManager->GetMoveCountdownTime();
}

ElapsedS ClosureControlDelegate::GetWaitingForMotionCountdownTime()
{
	/* This function should return the waiting for motion countdown time.
	   For now, we will return kDefaultCountdownTime. */
	return kDefaultCountdownTime;
}

CHIP_ERROR ClosureControlEndpoint::Init()
{
	ClusterConformance conformance;
	conformance.FeatureMap().Set(Feature::kPositioning).Set(Feature::kSpeed).Set(Feature::kVentilation);
	conformance.OptionalAttributes().Set(OptionalAttributeEnum::kCountdownTime);

	ClusterInitParameters initParams;

	ReturnErrorOnFailure(mLogic.Init(conformance, initParams));
	ReturnErrorOnFailure(mInterface.Init());

	return CHIP_NO_ERROR;
}

CHIP_ERROR ClosureControlEndpoint::WriteAllAttributes(const MainStateEnum &mainState,
						      const GenericOverallCurrentState &currentState,
						      const GenericOverallTargetState &targetState)
{
	chip::DeviceLayer::StackLock lock;
	ReturnErrorOnFailure(mLogic.SetMainState(mainState));
	ReturnErrorOnFailure(mLogic.SetOverallCurrentState(currentState));
	ReturnErrorOnFailure(mLogic.SetOverallTargetState(targetState));
	ReturnErrorOnFailure(mLogic.SetCountdownTimeFromDelegate(mDelegate.GetMovingCountdownTime()));
	return CHIP_NO_ERROR;
}
```

## src/closure_control_endpoint.h
```c
/*
 * Copyright (c) 2025 Nordic Semiconductor ASA
 *
 * SPDX-License-Identifier: LicenseRef-Nordic-5-Clause
 */

#pragma once

#include <app/clusters/closure-control-server/closure-control-cluster-delegate.h>
#include <app/clusters/closure-control-server/closure-control-cluster-logic.h>
#include <app/clusters/closure-control-server/closure-control-cluster-matter-context.h>
#include <app/clusters/closure-control-server/closure-control-cluster-objects.h>
#include <app/clusters/closure-control-server/closure-control-server.h>

#include "pwm/pwm_device.h"
#include <app-common/zap-generated/cluster-objects.h>
#include <app/TestEventTriggerDelegate.h>
#include <lib/core/CHIPError.h>
#include <lib/core/DataModelTypes.h>
#include <protocols/interaction_model/StatusCode.h>

class ClosureManager;

/**
 * @class ClosureControlDelegate
 * @class Handles communication with the matter stack
 *
 * This class is responsible for comminicating with the Matter stack
 * It implements callback, such as HandleStopCommand, HandleMoveToCommand, HandleCalibrateCommand
 * That are called by Matter stack whenever a command is Invoked.
 * It also implements functions such as GetCalibrationCountdownTime, GetMovingCountdownTime,
 * GetWaitingForMotionCountdownTime That are called by Matter stack when it requires to know this information It mostly
 * forwards the callbacks, and receives data from ClosureManager
 * @param mManager Pointer to the ClosureManager
 * @param mLogic Pointer to the ClusterLogic (Matter stack implementation of ClosureControl)
 */
class ClosureControlDelegate : public chip::app::Clusters::ClosureControl::DelegateBase {
	using MainStateEnum = chip::app::Clusters::ClosureControl::MainStateEnum;
	using ThreeLevelAutoEnum = chip::app::Clusters::Globals::ThreeLevelAutoEnum;
	using GenericOverallCurrentState = chip::app::Clusters::ClosureControl::GenericOverallCurrentState;
	using GenericOverallTargetState = chip::app::Clusters::ClosureControl::GenericOverallTargetState;
	using TargetPositionEnum = chip::app::Clusters::ClosureControl::TargetPositionEnum;
	using ClusterLogic = chip::app::Clusters::ClosureControl::ClusterLogic;
	using MatterContext = chip::app::Clusters::ClosureControl::MatterContext;
	using ElapsedS = chip::ElapsedS;
	using EndpointId = chip::EndpointId;
	using Interface = chip::app::Clusters::ClosureControl::Interface;
	using Status = chip::Protocols::InteractionModel::Status;

public:
	ClosureControlDelegate() {}

	Status HandleStopCommand() override;
	Status HandleMoveToCommand(const chip::Optional<TargetPositionEnum> &position,
				   const chip::Optional<bool> &latch,
				   const chip::Optional<ThreeLevelAutoEnum> &speed) override;
	Status HandleCalibrateCommand() override;
	void SetManager(ClosureManager *manager) { mManager = manager; }
	bool IsReadyToMove() override;
	ElapsedS GetCalibrationCountdownTime() override;
	ElapsedS GetMovingCountdownTime() override;
	ElapsedS GetWaitingForMotionCountdownTime() override;

	void SetLogic(ClusterLogic *logic) { mLogic = logic; }

	ClusterLogic *GetLogic() const { return mLogic; }

private:
	ClosureManager *mManager = nullptr;
	ClusterLogic *mLogic;
};

/**
 * @class ClosureControlEndpoint
 * @brief Represents a Closure Control cluster endpoint.
 *
 * This class encapsulates the logic and interfaces required to manage a Closure Control cluster
 * endpoint. It integrates the delegate, context, logic, and interface components for the
 * endpoint.
 *
 * @param mEndpoint The endpoint ID associated with this Closure Control endpoint.
 * @param mContext The Matter context for the endpoint.
 * @param mDelegate The delegate instance for handling commands.
 * @param mLogic The cluster logic associated with the endpoint.
 * @param mInterface The interface for interacting with the cluster.
 */
class ClosureControlEndpoint {
public:
	using MainStateEnum = chip::app::Clusters::ClosureControl::MainStateEnum;
	using ThreeLevelAutoEnum = chip::app::Clusters::Globals::ThreeLevelAutoEnum;
	using GenericOverallCurrentState = chip::app::Clusters::ClosureControl::GenericOverallCurrentState;
	using GenericOverallTargetState = chip::app::Clusters::ClosureControl::GenericOverallTargetState;
	using TargetPositionEnum = chip::app::Clusters::ClosureControl::TargetPositionEnum;
	using ClusterLogic = chip::app::Clusters::ClosureControl::ClusterLogic;
	using MatterContext = chip::app::Clusters::ClosureControl::MatterContext;
	using ElapsedS = chip::ElapsedS;
	using EndpointId = chip::EndpointId;
	using Interface = chip::app::Clusters::ClosureControl::Interface;
	ClosureControlEndpoint(EndpointId endpoint)
		: mEndpoint(endpoint), mContext(mEndpoint), mDelegate(), mLogic(mDelegate, mContext),
		  mInterface(mEndpoint, mLogic)
	{
		mDelegate.SetLogic(&mLogic);
	}
	/**
	 * @brief Updates all the attributes in the Matter Stack
	 *
	 * @param mainState new MainState
	 * @param currentState newCurrentState
	 * @param targetState newTargetState
	 *
	 * @return CHIP_ERROR indicating the result of the operation
	 */

	CHIP_ERROR WriteAllAttributes(const MainStateEnum &mainState, const GenericOverallCurrentState &currentState,
				      const GenericOverallTargetState &targetState);
	/**
	 * @brief Initializes the ClosureControlEndpoint instance.
	 *
	 * @return CHIP_ERROR indicating the result of the initialization.
	 */
	CHIP_ERROR Init();

	/**
	 * @brief Retrieves the delegate associated with this Closure Control endpoint.
	 *
	 * @return Reference to the ClosureControlDelegate instance.
	 */
	ClosureControlDelegate &GetDelegate() { return mDelegate; }

	/**
	 * @brief Returns a reference to the ClusterLogic instance associated with this object.
	 *
	 * @return ClusterLogic& Reference to the internal ClusterLogic object.
	 */
	ClusterLogic &GetLogic() { return mLogic; }

private:
	EndpointId mEndpoint = chip::kInvalidEndpointId;
	MatterContext mContext;
	ClosureControlDelegate mDelegate;
	ClusterLogic mLogic;
	Interface mInterface;
};
```

## src/closure_manager.cpp
```c
/*
 * Copyright (c) 2025 Nordic Semiconductor ASA
 *
 * SPDX-License-Identifier: LicenseRef-Nordic-5-Clause
 */

#include "closure_manager.h"
#include "closure_control_endpoint.h"

#include <app-common/zap-generated/cluster-objects.h>
#include <app/util/attribute-storage.h>
#include <dk_buttons_and_leds.h>
#include <platform/CHIPDeviceLayer.h>

#include <app-common/zap-generated/attributes/Accessors.h>

#include <zephyr/kernel.h>
#include <zephyr/logging/log.h>

#include "physical_device.h"

#include "finite_map.h"

LOG_MODULE_DECLARE(closure_manager, CONFIG_CHIP_APP_LOG_LEVEL);

using namespace chip;
using namespace chip::app;
using namespace chip::DeviceLayer;
using namespace chip::app::Clusters::ClosureControl;
using namespace chip::app::Clusters::Globals;

/* If you plan to dynamically populate the maps change the ExactPos2Enum function to support that */
static Nrf::FiniteMap<TargetPositionEnum, uint16_t, 5> sPositionMapTarget = { {
	{ TargetPositionEnum::kMoveToFullyClosed, 10000 },
	{ TargetPositionEnum::kMoveToFullyOpen, 0 },
	{ TargetPositionEnum::kMoveToPedestrianPosition, 0 },
	{ TargetPositionEnum::kMoveToSignaturePosition, 0 },
	{ TargetPositionEnum::kMoveToVentilationPosition, 7500 },
} };

static Nrf::FiniteMap<CurrentPositionEnum, uint16_t, 5> sPositionMapCurr = { {
	{ CurrentPositionEnum::kFullyClosed, 10000 },
	{ CurrentPositionEnum::kFullyOpened, 0 },
	{ CurrentPositionEnum::kOpenedForPedestrian, 0 },
	{ CurrentPositionEnum::kOpenedAtSignature, 0 },
	{ CurrentPositionEnum::kOpenedForVentilation, 7500 },
} };

static Nrf::FiniteMap<Clusters::Globals::ThreeLevelAutoEnum, uint16_t, 4> sSpeedMap = { {
	{ Clusters::Globals::ThreeLevelAutoEnum::kLow, 1000 },
	{ Clusters::Globals::ThreeLevelAutoEnum::kMedium, 2500 },
	{ Clusters::Globals::ThreeLevelAutoEnum::kHigh, 5000 },
	{ Clusters::Globals::ThreeLevelAutoEnum::kAuto, 2500 },
} };

namespace
{
constexpr uint32_t kCountdownTimeSeconds = 10;

/* Define the Namespace and Tag for the endpoint */
constexpr uint8_t kNamespaceClosure = 0x44;
constexpr uint8_t kTagClosureGarageDoor = 0x05;

/* Define the list of semantic tags for the endpoint */
const Clusters::Descriptor::Structs::SemanticTagStruct::Type kClosureControlEndpointTagList[] = {
	{ .namespaceID = kNamespaceClosure,
	  .tag = kTagClosureGarageDoor,
	  .label = chip::MakeOptional(DataModel::Nullable<chip::CharSpan>("Closure.GarageDoor"_span)) }
};

} // namespace
CurrentPositionEnum ExactPos2Enum(uint16_t currPositionExact)
{
	/* This implementation assumes that the map is full (which it is) */
	for (auto &item : sPositionMapCurr.mMap) {
		if (currPositionExact == item.value) {
			return item.key;
		}
	}
	return CurrentPositionEnum::kPartiallyOpened;
}

ClosureManager::ClosureManager(IPhysicalDevice &device, chip::EndpointId closureEndpoint)
	: mPhysicalDevice(device), mClosureControlEndpoint(closureEndpoint), mClosureEndpoint(closureEndpoint)
{
	mMainState = MainStateEnum::kStopped;
	mCurrentState.position = chip::MakeOptional(CurrentPositionEnum::kFullyOpened);
	mCurrentState.speed = chip::MakeOptional(ThreeLevelAutoEnum::kAuto);
	mTargetState.speed = chip::MakeOptional(ThreeLevelAutoEnum::kAuto);
}

CHIP_ERROR ClosureManager::Init()
{
	ReturnErrorOnFailure(mPhysicalDevice.Init());
	mPhysicalDevice.SetObserver(this);
	DeviceLayer::StackLock lock;

	/* Closure endpoints initialization */
	mClosureControlEndpoint.GetDelegate().SetManager(this);
	ReturnErrorOnFailure(mClosureControlEndpoint.Init());

	/* Set Taglist for Closure endpoints */
	ReturnErrorOnFailure(SetTagList(
		mClosureEndpoint,
		Span<const Clusters::Descriptor::Structs::SemanticTagStruct::Type>(kClosureControlEndpointTagList)));

	ReturnErrorOnFailure(mClosureControlEndpoint.WriteAllAttributes(mMainState, mCurrentState, mTargetState));

	return CHIP_NO_ERROR;
}

chip::Protocols::InteractionModel::Status ClosureManager::OnCalibrateCommand()
{
	return chip::Protocols::InteractionModel::Status::UnsupportedCommand;
}

chip::Protocols::InteractionModel::Status ClosureManager::OnStopCommand()
{
	mPhysicalDevice.Stop();
	return chip::Protocols::InteractionModel::Status::Success;
}

chip::Protocols::InteractionModel::Status
ClosureManager::OnMoveToCommand(const chip::Optional<TargetPositionEnum> position, const chip::Optional<bool> latch,
				const chip::Optional<ThreeLevelAutoEnum> speed)
{
	if (!position.HasValue()) {
		return chip::Protocols::InteractionModel::Status::Failure;
	}
	auto pos = sPositionMapTarget[position.Value()];
	auto spd = sSpeedMap[speed.ValueOr(mCurrentState.speed.Value())];
	mPhysicalDevice.MoveTo(pos, spd);

	mMainState = MainStateEnum::kMoving;
	mTargetState.position = position;
	mTargetState.speed = speed;

	auto err = mClosureControlEndpoint.WriteAllAttributes(mMainState, mCurrentState, mTargetState);
	if (err != CHIP_NO_ERROR) {
		LOG_ERR("Unable to update attributes on move, error code: %lx", static_cast<long>(err.AsInteger()));
		return chip::Protocols::InteractionModel::Status::Failure;
	}
	return chip::Protocols::InteractionModel::Status::Success;
}

void ClosureManager::OnMovementStopped(uint16_t currentPosition)
{
	mCurrentState.position = MakeOptional(ExactPos2Enum(currentPosition));
	mCurrentState.speed = mTargetState.speed;
	mMainState = MainStateEnum::kStopped;
	mTargetState.position.ClearValue();
	mTargetState.speed.ClearValue();
	mMoveCountdownTime = 0;
	auto err = mClosureControlEndpoint.WriteAllAttributes(mMainState, mCurrentState, mTargetState);
	if (err != CHIP_NO_ERROR) {
		LOG_ERR("Unable to update attributes after stop, error code: %lx", static_cast<long>(err.AsInteger()));
	} else {
		LOG_DBG("Movement successfully stopped");
	}
}

void ClosureManager::OnMovementUpdate(uint16_t currentPosition, uint16_t timeLeft, bool justStarted)
{
	mCurrentState.position = MakeOptional(ExactPos2Enum(currentPosition));
	mMoveCountdownTime = timeLeft;
	/* 	It seems that the Cluster Logic currently doesn't support not marking change to countdown time as dirty
		This means that the countdown time is always reported, even if the change was due to normal time
	    passing. If the Cluster Logic changes, the value should be marked as reportable only if justStarted is true

	    It seems that the new fix makes it so that the justStarted is not needed, need to wait for marge to verify
	 */
	auto err = mClosureControlEndpoint.WriteAllAttributes(mMainState, mCurrentState, mTargetState);
	if (err != CHIP_NO_ERROR) {
		LOG_ERR("Unable to update attributes while moving, error code: %lx",
			static_cast<long>(err.AsInteger()));
	}
}

/* Implementation of this callback is required by matter 1.5*/
void MatterClosureControlClusterServerAttributeChangedCallback(const chip::app::ConcreteAttributePath &attributePath)
{
	LOG_DBG("Closure Control cluster ID: " ChipLogFormatMEI, ChipLogValueMEI(attributePath.mAttributeId));
}
```

## src/closure_manager.h
```c
/*
 * Copyright (c) 2025 Nordic Semiconductor ASA
 *
 * SPDX-License-Identifier: LicenseRef-Nordic-5-Clause
 */

/*
 * @class ClosureManager
 * @brief Manages the initialization and operations related to closure and
 *        closure panel endpoints in the application.
 *
 * @note This class is part of the closure application example
 */

#pragma once

#include "board/board.h"
#include "closure_control_endpoint.h"
#include "physical_device.h"
#include "physical_device_observer.h"
#include <lib/core/DataModelTypes.h>
#include <zephyr/kernel.h>

class ClosureManager : public IPhysicalDeviceObserver {
	using TargetPositionEnum = chip::app::Clusters::ClosureControl::TargetPositionEnum;
	using MainStateEnum = chip::app::Clusters::ClosureControl::MainStateEnum;
	using ThreeLevelAutoEnum = chip::app::Clusters::Globals::ThreeLevelAutoEnum;
	using GenericOverallCurrentState = chip::app::Clusters::ClosureControl::GenericOverallCurrentState;
	using GenericOverallTargetState = chip::app::Clusters::ClosureControl::GenericOverallTargetState;
	using ElapsedS = chip::ElapsedS;

public:
	ClosureManager(IPhysicalDevice &device, chip::EndpointId closureEndpoint);

	CHIP_ERROR Init();

	chip::Protocols::InteractionModel::Status OnCalibrateCommand();

	/**
	 * @brief Handles the MoveTo command for the Closure.
	 *
	 * This method processes the MoveTo command, which is used to initiate a motion action
	 * for a closure.
	 *
	 * @param position Optional target position for the closure device.
	 * @param latch Optional flag indicating whether the closure should latch after moving.
	 * @param speed Optional speed setting for the movement, represented as a ThreeLevelAutoEnum.
	 * @return chip::Protocols::InteractionModel::Status Status of the command handling operation.
	 */
	chip::Protocols::InteractionModel::Status OnMoveToCommand(const chip::Optional<TargetPositionEnum> position,
								  const chip::Optional<bool> latch,
								  const chip::Optional<ThreeLevelAutoEnum> speed);

	/**
	 * @brief Handles the Stop command for the Closure.
	 *
	 * This method processes the Stop command, which is used to stop an action for a closure.
	 *
	 * @return chip::Protocols::InteractionModel::Status
	 *         Returns Status::Success if the Stop command is handled successfully,
	 *         or an appropriate error status otherwise.
	 */
	chip::Protocols::InteractionModel::Status OnStopCommand();

	void OnMovementStopped(uint16_t currentPosition) override;
	void OnMovementUpdate(uint16_t currentPosition, uint16_t timeLeft, bool justStarted = false) override;

	ElapsedS GetMoveCountdownTime() { return mMoveCountdownTime; }

private:
	ElapsedS mMoveCountdownTime = 0;
	IPhysicalDevice &mPhysicalDevice;
	MainStateEnum mMainState;
	GenericOverallCurrentState mCurrentState;
	GenericOverallTargetState mTargetState;

	ClosureControlEndpoint mClosureControlEndpoint;
	const chip::EndpointId mClosureEndpoint;
};
```

## src/physical_device.h
```c
/*
 * Copyright (c) 2025 Nordic Semiconductor ASA
 *
 * SPDX-License-Identifier: LicenseRef-Nordic-5-Clause
 */

#pragma once
#include <lib/core/CHIPError.h>

#include "physical_device_observer.h"

class IPhysicalDevice {
public:
	virtual ~IPhysicalDevice() = default;

	IPhysicalDevice() = default;
	IPhysicalDevice(const IPhysicalDevice &) = delete;
	IPhysicalDevice &operator=(const IPhysicalDevice &) = delete;

	void SetObserver(IPhysicalDeviceObserver *observer) { mObserver = observer; }
	virtual CHIP_ERROR Init() = 0;
	virtual CHIP_ERROR MoveTo(uint16_t position, uint16_t speed) = 0;
	virtual CHIP_ERROR Stop() = 0;

protected:
	IPhysicalDeviceObserver *mObserver = nullptr;
};
```

## src/physical_device_observer.h
```c
/*
 * Copyright (c) 2025 Nordic Semiconductor ASA
 *
 * SPDX-License-Identifier: LicenseRef-Nordic-5-Clause
 */

#pragma once
#include <cstdint>

class IPhysicalDeviceObserver {
public:
	virtual void OnMovementStopped(uint16_t currentPosition) = 0;
	virtual void OnMovementUpdate(uint16_t currentPosition, uint16_t timeLeft, bool justStarted = false) = 0;
	virtual ~IPhysicalDeviceObserver() = default;
};
```

## src/physical_emulator.cpp
```c
/*
 * Copyright (c) 2025 Nordic Semiconductor ASA
 *
 * SPDX-License-Identifier: LicenseRef-Nordic-5-Clause
 */

#include "physical_emulator.h"
#include "closure_manager.h"
#include <app-common/zap-generated/attributes/Accessors.h>
#include <zephyr/logging/log.h>

LOG_MODULE_DECLARE(app, CONFIG_CHIP_APP_LOG_LEVEL);

using namespace chip;
using namespace chip::DeviceLayer;

static constexpr uint32_t kMoveIntervalMs = 100;

PhysicalEmulator::PhysicalEmulator(const pwm_dt_spec *spec) : mSpec(spec) {}

CHIP_ERROR PhysicalEmulator::Init()
{
	if (mPhysicalIndicator.Init(mSpec, 0, 255) != 0) {
		LOG_ERR("Cannot initialize the physical indicator");
		return CHIP_ERROR_INCORRECT_STATE;
	}
	LOG_DBG("PhysicalEmulator initialized");
	return CHIP_NO_ERROR;
}

CHIP_ERROR PhysicalEmulator::MoveTo(uint16_t position, uint16_t speed)
{
	LOG_DBG("Starting movement");
	mTargetPosition = position;
	mSpeed = speed;

	ReturnErrorOnFailure(
		SystemLayer().StartTimer(System::Clock::Milliseconds32(kMoveIntervalMs), TimerTimeoutCallback, this));
	mJustStarted = true;
	return CHIP_NO_ERROR;
}

CHIP_ERROR PhysicalEmulator::Stop()
{
	SystemLayer().CancelTimer(TimerTimeoutCallback, this);
	LOG_DBG("Movement stopped");
	mObserver->OnMovementStopped(mCurrentPosition);
	return CHIP_NO_ERROR;
}

void PhysicalEmulator::TimerTimeoutCallback(System::Layer *systemLayer, void *appState)
{
	auto *self = static_cast<PhysicalEmulator *>(appState);
	VerifyOrReturn(self != nullptr);
	self->HandleTimer();
}

void PhysicalEmulator::HandleTimer()
{
	bool finished = false;
	uint32_t movePerTick32 = (static_cast<uint32_t>(mSpeed) * kMoveIntervalMs) / 1000U;
	uint16_t movePerTick = static_cast<uint16_t>(std::min<uint32_t>(movePerTick32, UINT16_MAX));
	uint16_t distanceLeft = 0;
	if (mCurrentPosition <= mTargetPosition) {
		distanceLeft = mTargetPosition - mCurrentPosition;
		if (movePerTick >= distanceLeft) {
			finished = true;
			mCurrentPosition = mTargetPosition;
		} else {
			mCurrentPosition += movePerTick;
		}
	} else {
		distanceLeft = mCurrentPosition - mTargetPosition;
		if (movePerTick >= distanceLeft) {
			finished = true;
			mCurrentPosition = mTargetPosition;
		} else {
			mCurrentPosition -= movePerTick;
		}
	}

	uint8_t brightness = static_cast<uint8_t>((static_cast<uint32_t>(mCurrentPosition) * 255U + 5000U) / 10000U);

	mPhysicalIndicator.InitiateAction(Nrf::PWMDevice::LEVEL_ACTION, 0, &brightness);

	if (finished) {
		Stop();
	} else {
		uint32_t timeLeftMs = (static_cast<uint32_t>(distanceLeft) * kMoveIntervalMs) / movePerTick;
		uint16_t timeLeftS = static_cast<uint16_t>((timeLeftMs + 999) / 1000); /*ceil*/
		mObserver->OnMovementUpdate(mCurrentPosition, timeLeftS, mJustStarted);
		mJustStarted = false;
		auto err = SystemLayer().StartTimer(System::Clock::Milliseconds32(kMoveIntervalMs),
						    TimerTimeoutCallback, this);
		if (err != CHIP_NO_ERROR) {
			LOG_ERR("Timer failed to restart, chip error code: %lx", static_cast<long>(err.AsInteger()));
		}
	}
}
```
